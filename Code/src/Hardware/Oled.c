#include "Oled.h"

#include <avr/pgmspace.h>
#include <util/delay.h>
#include <string.h>

#include "PinDefinition.h"
#include "../Globals.h"
#include "Spi.h"

#if defined(STORE_SCREEN_BUFFER_IN_FRAM)
#include "Fram.h"
#endif

#define WIDTH 128
#define HEIGHT 64

#ifndef STORE_SCREEN_BUFFER_IN_FRAM
static uint8_t buffer[SSD1306_LCDHEIGHT * SSD1306_LCDWIDTH / 8] =
{
	0x00, 0x00, 0x00, 0x00, 0x00, 0x00, 0x00, 0x00, 0x00, 0x00, 0x00, 0x00, 0x00, 0x00, 0x00, 0x00,
	0x00, 0x00, 0x00, 0x80, 0xC0, 0xC0, 0xE0, 0x70, 0x70, 0x00, 0x00, 0x00, 0x00, 0x00, 0x00, 0x00,
	0x00, 0x00, 0x00, 0x00, 0x00, 0x00, 0x00, 0x00, 0x00, 0x00, 0x00, 0x00, 0x00, 0x00, 0x00, 0x00,
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	0x00, 0x00, 0x00, 0x00, 0x00, 0x00, 0x00, 0x00, 0x00, 0x00, 0x00, 0x00, 0x00, 0x00, 0x00, 0x00
};
#endif

// Hardware

/**
 * @brief Pull the data/command pin high.
 */
static void oled_dc_high(void)
{
	OLED_DC_PORT |= (1 << OLED_DC_PIN_NUM);
}

/**
 * @brief Pull the data/command pin low.
 */
static void oled_dc_low(void)
{
	OLED_DC_PORT &= ~(1 << OLED_DC_PIN_NUM);
}


/**
 * @brief Pull the reset pin high.
 */
static void oled_reset_high(void)
{
	OLED_RES_PORT |= (1 << OLED_RES_PIN_NUM);
}

/**
 * @brief Pull the reset pin low.
 */
static void oled_reset_low(void)
{
	OLED_RES_PORT &= ~(1 << OLED_RES_PIN_NUM);
}

/**
 * @brief Pull the CS pin high.
 */
static void oled_deselect(void)
{
	OLED_CS_PORT |= (1 << OLED_CS_PIN_NUM);
}

/**
 * @brief Pull the CS pin low.
 */
static void oled_select(void)
{
	OLED_CS_PORT &= ~(1 << OLED_CS_PIN_NUM);
}

void oled_setup_hardware()
{
	OLED_CS_DDR |= (1 << OLED_CS_PIN_NUM);
	OLED_DC_DDR |= (1 << OLED_DC_PIN_NUM);
	OLED_RES_DDR |= (1 << OLED_RES_PIN_NUM);

	oled_reset_low();
	oled_deselect();
	oled_dc_low();
}

// Software

/**
 * @brief Send a command to the oled display.
 * @details Use it if you really know what you are doing.
 * 
 * @param c The byte to send as a command.
 */
static void oled_command(uint8_t c)
{
	oled_deselect();
	oled_dc_low();
	oled_select();
	spi_send_8(c);
	oled_deselect();
}

static const uint8_t oled_init_cmd[] PROGMEM =
{
	SSD1306_DISPLAYOFF,
	SSD1306_SETDISPLAYCLOCKDIV,
	0x80,
	SSD1306_SETMULTIPLEX,
	SSD1306_LCDHEIGHT - 1,
	SSD1306_SETDISPLAYOFFSET,
	0x0,
	SSD1306_SETSTARTLINE | 0x0,
	SSD1306_CHARGEPUMP,
	0x14,
	SSD1306_MEMORYMODE,
	0x00,
	SSD1306_SEGREMAP | 0x1,
	SSD1306_COMSCANDEC,
	SSD1306_SETCOMPINS,
	0x12,
	SSD1306_SETCONTRAST,
	0xCF,
	SSD1306_SETPRECHARGE,
	0xF1,
	SSD1306_SETVCOMDETECT,
	0x40,
	SSD1306_DISPLAYALLON_RESUME,
	SSD1306_NORMALDISPLAY,
	SSD1306_DEACTIVATE_SCROLL,
	SSD1306_DISPLAYON
};

void oled_init()
{
	oled_reset_high();
	_delay_ms(1);
	// bring reset low
	oled_reset_low();

	// wait 10ms
	_delay_ms(10);
	// bring out of reset
	oled_reset_high();

	// Init sequence
	for(uint8_t i = 0; i < 26; ++i)
	{
		oled_command(pgm_read_byte_near(oled_init_cmd + i));
	}
}

// the most basic function, set a single pixel
void oled_draw_pixel(uint8_t x, uint8_t y, uint8_t color)
{
	if( x & 0x80 || y & 0x40)
		return;
	// check rotation, move pixel around if necessary
	if(OPTIONS_FLAG & (1 << OPTIONS_FLAG_OFFSET_ORIENTATION))
	{
		x = 127 - x;
		y = 63 - y;
	}

	// x is which column
	#ifdef STORE_SCREEN_BUFFER_IN_FRAM

	uint8_t buf = fram_read_byte(OFFSET_OLED_BUFFER + (x+ (y/8)*WIDTH));
	uint8_t val = (1 << (y&7));
	switch (color)
	{
	case WHITE:
		buf |= val;
		break;
	case BLACK:
		buf &= ~val;
		break;
	case INVERSE:
		buf ^= val;
		break;
	}
	fram_write_byte(OFFSET_OLED_BUFFER + (x+ (y/8)*WIDTH), buf);

	#else

	uint8_t* buf = &buffer[x+ (y/8)*WIDTH];
	uint8_t val = (1 << (y&7));
	switch (color)
	{
	case WHITE:
		(*buf) |=  val;
		break;
	case BLACK:
		(*buf) &= ~val;
		break;
	case INVERSE:
		(*buf) ^=  val;
		break;
	}

	#endif
}

void oled_invert_display(uint8_t i)
{
	oled_command(i ? SSD1306_INVERTDISPLAY : SSD1306_NORMALDISPLAY);
}

// Dim the display
// dim = true: display is dimmed
// dim = false: display is normal
void oled_dim(uint8_t dim)
{
	// the range of contrast to too small to be really useful
	// it is useful to dim the display
	oled_command(SSD1306_SETCONTRAST);
	oled_command(dim ? 0 : 0xCF);
}

void oled_display(void)
{
	oled_command(SSD1306_COLUMNADDR);
	oled_command(0);   // Column start address (0 = reset)
	oled_command(SSD1306_LCDWIDTH-1);  // Column end address (127 = reset)

	oled_command(SSD1306_PAGEADDR);
	oled_command(0);  // Page start address (0 = reset)

	oled_command(7);  // Page end address

	oled_deselect();
	oled_dc_high();
	oled_select();

	#ifdef STORE_SCREEN_BUFFER_IN_FRAM
	uint8_t pixBuff[64];

	uint8_t i = 0;
	uint8_t j = 0;
	for(; i < ((HEIGHT * WIDTH / 8) / 64); ++i)
	{
		oled_deselect();
		fram_read_bytes(OFFSET_OLED_BUFFER + i*64, pixBuff, 64);
		oled_select();
		for(j = 0; j < 64; ++j)
		{
			spi_send_8(pixBuff[j]);
		}
	}
	#else

	uint16_t i = 0;
	for (; i < (HEIGHT * WIDTH / 8); ++i)
	{
		spi_send_8(buffer[i]);
	}
	#endif

	oled_deselect();
}

// clear everything
void oled_clear_display(void)
{
	#ifdef STORE_SCREEN_BUFFER_IN_FRAM
	uint8_t i = 0;
	for(; i < ((HEIGHT * WIDTH / 8) / 128); ++i)
	{
		fram_set(i*128, 0, 128);
	}
	#else
	uint16_t i = 0;
	for (; i < (HEIGHT * WIDTH / 8); ++i)
	{
		buffer[i] = 0;
	}
	#endif
}

void oled_active_display(uint8_t active)
{
	if(active)
	{
		oled_command(SSD1306_DISPLAYON);
	}
	else
	{
		oled_command(SSD1306_DISPLAYOFF);
	}
}